## firmware/controller/sdkconfig.defaults
```kconfig
CONFIG_ESP_CONSOLE_USB_SERIAL_JTAG=y
CONFIG_ESP_CONSOLE_SECONDARY_NONE=y
CONFIG_ESP_SYSTEM_PANIC_PRINT_REBOOT=y
CONFIG_ESP_TASK_WDT_EN=y
CONFIG_ESP_TASK_WDT_PANIC=y
CONFIG_COMPILER_OPTIMIZATION_DEBUG=y
CONFIG_ESPTOOLPY_FLASHSIZE_8MB=y
CONFIG_HB_BACKPACK_SOURCE_MAC="000000000000"
```

## firmware/controller/src/Kconfig.projbuild
```kconfig
menu "Haptic bracelet"

config HB_BACKPACK_SOURCE_MAC
    string "ExpressLRS Backpack source MAC"
    default "000000000000"
    help
        Twelve hexadecimal digits (separators optional). Frames from any other
        ESP-NOW sender are discarded. All zeroes disable Backpack reception.

config HB_BACKPACK_WIFI_CHANNEL
    int "ExpressLRS Backpack ESP-NOW channel"
    range 1 14
    default 1

endmenu
```
